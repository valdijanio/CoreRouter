## os/Config.in
```kconfig
source "$BR2_EXTERNAL_COREROUTER_PATH/package/corerouter/Config.in"
source "$BR2_EXTERNAL_COREROUTER_PATH/package/corerouter-installer/Config.in"
```

## os/package/corerouter-firmware/Config.in
```kconfig
config BR2_PACKAGE_COREROUTER_FIRMWARE
	bool "corerouter-firmware"
	select BR2_PACKAGE_WIRELESS_REGDB
	help
	  The firmware the kernel's network drivers declare (G1.6j), from
	  the linux-firmware files pinned in firmware.lock, with their
	  licenses. `cargo xtask os build` downloads, checks and stages
	  them.

	  G1.30: and cfg80211's regulatory database, from the
	  wireless-regdb package: this package is the one that fills
	  /lib/firmware.
```

## os/package/corerouter-installer/Config.in
```kconfig
config BR2_PACKAGE_COREROUTER_INSTALLER
	bool "corerouter-installer"
	depends on BR2_LINUX_KERNEL
	depends on BR2_PACKAGE_COREROUTER
	help
	  The installer's kernel (G1.6c): the image's kernel source and
	  configuration with its own built-in command line, no BTF, and
	  an initramfs with corerouter-init (installer mode) and the
	  image keys. Boots from the ISO's El Torito/ESP image as
	  EFI/BOOT/BOOTX64.EFI.
```

## os/package/corerouter/Config.in
```kconfig
config BR2_PACKAGE_COREROUTER
	bool "corerouter"
	depends on BR2_x86_64
	depends on BR2_TOOLCHAIN_USES_GLIBC
	help
	  corerouter-daemon (the router) and corerouter-init (PID 1),
	  built from this workspace with the host's cargo and linked
	  with the Buildroot toolchain against its glibc.
```
